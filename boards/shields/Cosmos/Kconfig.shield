## boards/shields/Cosmos/Kconfig.shield
```kconfig
# No whitespace after the comma or in your part name!
config SHIELD_Cosmos_LEFT
    def_bool $(shields_list_contains,Cosmos_left)

# No whitespace after the comma or in your part name!
config SHIELD_Cosmos_RIGHT
    def_bool $(shields_list_contains,Cosmos_right)
```
